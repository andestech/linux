## arch/riscv/Kconfig.erratas
```kconfig
menu "CPU errata selection"

config ERRATA_ANDES
	bool "Andes errata"
	depends on !XIP_KERNEL
	select RISCV_ALTERNATIVE
	help
	  All Andes errata Kconfig depend on this Kconfig. Disabling
	  this Kconfig will disable all Andes errata. Please say "Y"
	  here if your platform uses Andes CPU cores.

	  Otherwise, please say "N" here to avoid unnecessary overhead.

config ERRATA_ANDES_LEGACY_MMU
	bool "Apply Andes errata legacy MMU"
	depends on ERRATA_ANDES
	default y
	help
	  This will apply the Andes legacy MMU errata. We need to
	  flush TLB immediately after a new PTE is allocated because
	  the legacy MMU could retrieve stale data even if the PTE is
	  updated. Note that legacy MMU only exists in Andes 2X-series CPU.

	  If you don't know what to do here, say "Y".

config ERRATA_ANDES_PA_MSB
	bool "Apply Andes errata physical address MSB"
	depends on ERRATA_ANDES
	select RISCV_ALTERNATIVE_EARLY
	default y
	help
	  This will apply the Andes physical address MSB errata.
	  Use the MSB of physical address to distinguish cacheable
	  memory for Andes 25 series CPUs.

	  If you don't know what to do here, say "Y".

config ERRATA_ANDES_HPM
	bool "Apply Andes HPM errata"
	depends on ERRATA_ANDES
	default y
	help
	  The Andes cores implement a HPM overflow extension very
	  similar to the core SSCOFPMF extension.

	  This will apply the overflow errata to handle the non-standard
	  behavious via the regular SBI PMU driver and interface.

	  If you don't know what to do here, say "Y".

config ERRATA_SIFIVE
	bool "SiFive errata"
	depends on !XIP_KERNEL
	select RISCV_ALTERNATIVE
	help
	  All SiFive errata Kconfig depend on this Kconfig. Disabling
	  this Kconfig will disable all SiFive errata. Please say "Y"
	  here if your platform uses SiFive CPU cores.

	  Otherwise, please say "N" here to avoid unnecessary overhead.

config ERRATA_SIFIVE_CIP_453
	bool "Apply SiFive errata CIP-453"
	depends on ERRATA_SIFIVE && 64BIT
	default y
	help
	  This will apply the SiFive CIP-453 errata to add sign extension
	  to the $badaddr when exception type is instruction page fault
	  and instruction access fault.

	  If you don't know what to do here, say "Y".

config ERRATA_SIFIVE_CIP_1200
	bool "Apply SiFive errata CIP-1200"
	depends on ERRATA_SIFIVE && 64BIT
	default y
	help
	  This will apply the SiFive CIP-1200 errata to repalce all
	  "sfence.vma addr" with "sfence.vma" to ensure that the addr
	  has been flushed from TLB.

	  If you don't know what to do here, say "Y".

config ERRATA_THEAD
	bool "T-HEAD errata"
	depends on !XIP_KERNEL
	select RISCV_ALTERNATIVE
	help
	  All T-HEAD errata Kconfig depend on this Kconfig. Disabling
	  this Kconfig will disable all T-HEAD errata. Please say "Y"
	  here if your platform uses T-HEAD CPU cores.

	  Otherwise, please say "N" here to avoid unnecessary overhead.

config ERRATA_THEAD_PBMT
	bool "Apply T-Head memory type errata"
	depends on ERRATA_THEAD && 64BIT && MMU
	select RISCV_ALTERNATIVE_EARLY
	default y
	help
	  This will apply the memory type errata to handle the non-standard
	  memory type bits in page-table-entries on T-Head SoCs.

	  If you don't know what to do here, say "Y".

config ERRATA_THEAD_CMO
	bool "Apply T-Head cache management errata"
	depends on ERRATA_THEAD && MMU
	select RISCV_DMA_NONCOHERENT
	default y
	help
	  This will apply the cache management errata to handle the
	  non-standard handling on non-coherent operations on T-Head SoCs.

	  If you don't know what to do here, say "Y".

config ERRATA_THEAD_PMU
	bool "Apply T-Head PMU errata"
	depends on ERRATA_THEAD && RISCV_PMU_SBI
	default y
	help
	  The T-Head C9xx cores implement a PMU overflow extension very
	  similar to the core SSCOFPMF extension.

	  This will apply the overflow errata to handle the non-standard
	  behaviour via the regular SBI PMU driver and interface.

	  If you don't know what to do here, say "Y".

endmenu # "CPU errata selection"
```

## arch/riscv/Kconfig.socs
```kconfig
menu "SoC selection"

choice
	prompt "Andes Linux for AE350 platform or upstream riscv"
	default RECOVER_UPSTREAM_CONFIG_RISCV
	help
	  Andes Platform use PLAT_AE350 for Andes full features support.

config RECOVER_UPSTREAM_CONFIG_RISCV
	bool "Andes Linux kernel recover upstream config RISCV setting"
	select SIFIVE_PLIC
	select OF_DMA_DEFAULT_COHERENT
	select DMA_DIRECT_REMAP
	help
	  This enables support for recovering the upstream "config RISCV",
	  as setting in the arch/riscv/Kconfig. When selecting the PLAT_AE350
	  configuration, certain default enabled configurations from
	  "config RISCV" are not needed. Therefore, we modified these
	  configurations to be default-disabled and then re-enabled them
	  under this specific configuration.

config PLAT_AE350
	bool "Andes AE350 Platform"
	select SIFIVE_PLIC
	select ERRATA_ANDES if !XIP_KERNEL
	help
	  This enables support for Andes AE350 platform hardware.
endchoice

config ANDES_QEMU_SUPPORT
	bool "Andes QEMU SUPPORT"
	depends on SOC_SIFIVE
	default n
	help
	  Andes QEMU Support.

config SOC_MICROCHIP_POLARFIRE
	bool "Microchip PolarFire SoCs"
	select MCHP_CLK_MPFS
	select SIFIVE_PLIC
	help
	  This enables support for Microchip PolarFire SoC platforms.

config SOC_SIFIVE
	bool "SiFive SoCs"
	select SERIAL_SIFIVE if TTY
	select SERIAL_SIFIVE_CONSOLE if TTY
	select CLK_SIFIVE
	select CLK_SIFIVE_PRCI
	select SIFIVE_PLIC
	select ERRATA_SIFIVE if !XIP_KERNEL
	help
	  This enables support for SiFive SoC platform hardware.

config SOC_STARFIVE
	bool "StarFive SoCs"
	select PINCTRL
	select RESET_CONTROLLER
	select SIFIVE_PLIC
	select ARM_AMBA
	help
	  This enables support for StarFive SoC platform hardware.

config SOC_VIRT
	bool "QEMU Virt Machine"
	select CLINT_TIMER if RISCV_M_MODE
	select POWER_RESET
	select POWER_RESET_SYSCON
	select POWER_RESET_SYSCON_POWEROFF
	select GOLDFISH
	select RTC_DRV_GOLDFISH if RTC_CLASS
	select SIFIVE_PLIC
	select PM_GENERIC_DOMAINS if PM
	select PM_GENERIC_DOMAINS_OF if PM && OF
	select RISCV_SBI_CPUIDLE if CPU_IDLE && RISCV_SBI
	help
	  This enables support for QEMU Virt Machine.

config SOC_CANAAN
	bool "Canaan Kendryte K210 SoC"
	depends on !MMU
	select CLINT_TIMER if RISCV_M_MODE
	select SERIAL_SIFIVE if TTY
	select SERIAL_SIFIVE_CONSOLE if TTY
	select SIFIVE_PLIC
	select ARCH_HAS_RESET_CONTROLLER
	select PINCTRL
	select COMMON_CLK
	select COMMON_CLK_K210
	help
	  This enables support for Canaan Kendryte K210 SoC platform hardware.

if SOC_CANAAN

config SOC_CANAAN_K210_DTB_BUILTIN
	bool "Builtin device tree for the Canaan Kendryte K210"
	depends on SOC_CANAAN
	default y
	select OF
	select BUILTIN_DTB
	help
	  Build a device tree for the Kendryte K210 into the Linux image.
	  This option should be selected if no bootloader is being used.
	  If unsure, say Y.

config SOC_CANAAN_K210_DTB_SOURCE
	string "Source file for the Canaan Kendryte K210 builtin DTB"
	depends on SOC_CANAAN
	depends on SOC_CANAAN_K210_DTB_BUILTIN
	default "k210_generic"
	help
	  Base name (without suffix, relative to arch/riscv/boot/dts/canaan)
	  for the DTS file that will be used to produce the DTB linked into the
	  kernel.

endif # SOC_CANAAN

endmenu # "SoC selection"
```

## arch/riscv/configs/ae350_rv64_up_defconfig
```kconfig
CONFIG_DEFAULT_HOSTNAME="andes-test"
# CONFIG_SWAP is not set
CONFIG_SYSVIPC=y
CONFIG_POSIX_MQUEUE=y
CONFIG_HIGH_RES_TIMERS=y
CONFIG_PREEMPT=y
CONFIG_BSD_PROCESS_ACCT=y
CONFIG_BSD_PROCESS_ACCT_V3=y
CONFIG_IKCONFIG=y
CONFIG_IKCONFIG_PROC=y
CONFIG_LOG_BUF_SHIFT=14
CONFIG_CGROUPS=y
CONFIG_CGROUP_SCHED=y
CONFIG_CFS_BANDWIDTH=y
CONFIG_CGROUP_CPUACCT=y
CONFIG_NAMESPACES=y
CONFIG_USER_NS=y
CONFIG_CHECKPOINT_RESTORE=y
CONFIG_BLK_DEV_INITRD=y
CONFIG_INITRAMFS_SOURCE="rootfs-lite initramfs.txt.lite"
# CONFIG_RD_BZIP2 is not set
# CONFIG_RD_LZMA is not set
# CONFIG_RD_XZ is not set
# CONFIG_RD_LZO is not set
# CONFIG_RD_LZ4 is not set
CONFIG_INITRAMFS_COMPRESSION_GZIP=y
CONFIG_SYSCTL_SYSCALL=y
CONFIG_KALLSYMS_ALL=y
CONFIG_EMBEDDED=y
CONFIG_PROFILING=y
CONFIG_SOC_SIFIVE=y
CONFIG_ATCDMAC300=y
CONFIG_HZ_100=y
CONFIG_MODULES=y
CONFIG_MODULE_UNLOAD=y
# CONFIG_BLK_DEV_BSG is not set
CONFIG_PARTITION_ADVANCED=y
# CONFIG_EFI_PARTITION is not set
CONFIG_NET=y
CONFIG_PACKET=y
CONFIG_UNIX=y
CONFIG_NET_KEY=y
CONFIG_INET=y
# CONFIG_INET_DIAG is not set
# CONFIG_WIRELESS is not set
CONFIG_DEVTMPFS=y
CONFIG_DEVTMPFS_MOUNT=y
CONFIG_BLK_DEV_LOOP=y
CONFIG_NETDEVICES=y
CONFIG_TUN=y
CONFIG_FTMAC100=y
# CONFIG_WLAN is not set
CONFIG_INPUT_EVDEV=y
# CONFIG_INPUT_KEYBOARD is not set
# CONFIG_INPUT_MOUSE is not set
CONFIG_INPUT_TOUCHSCREEN=y
CONFIG_TOUCHSCREEN_CPE_TS_AE350=y
CONFIG_TOUCHSCREEN_CPE_TS_DEJITTER_AE350=y
CONFIG_DEVKMEM=y
CONFIG_SERIAL_8250=y
# CONFIG_SERIAL_8250_DEPRECATED_OPTIONS is not set
CONFIG_SERIAL_8250_CONSOLE=y
CONFIG_SERIAL_OF_PLATFORM=y
CONFIG_SERIAL_EARLYCON_RISCV_SBI=y
# CONFIG_HW_RANDOM is not set
CONFIG_I2C=y
CONFIG_I2C_CHARDEV=y
CONFIG_I2C_ATCIIC100=y
CONFIG_GPIOLIB=y
CONFIG_DEBUG_GPIO=y
CONFIG_GPIO_SYSFS=y
CONFIG_GPIO_ATCGPIO100=y
# CONFIG_HWMON is not set
CONFIG_FB=y
CONFIG_FB_FTLCDC100=y
CONFIG_DUMMY_CONSOLE_COLUMNS=40
CONFIG_DUMMY_CONSOLE_ROWS=30
CONFIG_FRAMEBUFFER_CONSOLE=y
CONFIG_LOGO=y
CONFIG_SOUND=y
CONFIG_SND=y
CONFIG_SND_OSSEMUL=y
CONFIG_SND_PCM_OSS=y
# CONFIG_USB_SUPPORT is not set
CONFIG_MMC=y
CONFIG_MMC_FTSDC=y
CONFIG_MMC_FTSDCG=y
CONFIG_DMADEVICES=y
CONFIG_ATCDMAC300G=y
# CONFIG_IOMMU_SUPPORT is not set
CONFIG_PWM=y
CONFIG_PWM_ATCPIT100=y
CONFIG_GENERIC_PHY=y
CONFIG_RISCV_PMU=y
CONFIG_EXT2_FS=y
CONFIG_EXT4_FS=y
CONFIG_EXT4_FS_POSIX_ACL=y
CONFIG_EXT4_FS_SECURITY=y
CONFIG_FANOTIFY=y
CONFIG_MSDOS_FS=y
CONFIG_VFAT_FS=y
CONFIG_TMPFS=y
CONFIG_TMPFS_POSIX_ACL=y
CONFIG_CONFIGFS_FS=y
# CONFIG_MISC_FILESYSTEMS is not set
CONFIG_NFS_FS=y
CONFIG_NFS_V3_ACL=y
CONFIG_NFS_V4=y
CONFIG_NFS_V4_1=y
CONFIG_NFS_V4_2=y
CONFIG_NFS_USE_LEGACY_DNS=y
CONFIG_NLS_CODEPAGE_437=y
CONFIG_NLS_ISO8859_1=y
CONFIG_CRYPTO_ECHAINIV=y
# CONFIG_CRYPTO_HW is not set
CONFIG_PRINTK_TIME=y
CONFIG_DEBUG_INFO=y
CONFIG_DEBUG_INFO_DWARF4=y
CONFIG_GDB_SCRIPTS=y
CONFIG_READABLE_ASM=y
CONFIG_DEBUG_FS=y
CONFIG_DEBUG_SECTION_MISMATCH=y
CONFIG_PANIC_ON_OOPS=y
# CONFIG_DEBUG_PREEMPT is not set
CONFIG_STACKTRACE=y
CONFIG_RCU_CPU_STALL_TIMEOUT=300
# CONFIG_FTRACE is not set
```

## arch/riscv/platforms/Kconfig
```kconfig
choice
	prompt "platform type"
	default PLAT_AE350

config PLAT_AE350
	bool "ae350 platform"

endchoice

if PLAT_AE350
source "arch/riscv/platforms/ae350/Kconfig"
endif

menu "Common Platform Options"

config PLATFORM_AHBDMA
	prompt "platform AHB DMA support"
	bool
	default y

endmenu
```

## drivers/video/fbdev/ftlcdc100/Kconfig
```kconfig
config FB_FTLCDC100
        tristate "Faraday FTLCDC100 driver"
        depends on FB
        select FB_CFB_FILLRECT
        select FB_CFB_COPYAREA
        select FB_CFB_IMAGEBLIT

	choice
		prompt "Default LCD Panel"
		depends on FB_FTLCDC100
		default PANEL_AUA036QN01
		help
		  This option select a default panel setting for the LCD controller

		config PANEL_AUA036QN01
			bool "AU 3.5 inch LCD Panel"

		config PANEL_CH7013A
			bool "Chrontel Digital PC to TV Encoder"
			select I2C
			select I2C_FARADAY
			select CH7013A

		config PANEL_AUA070VW04
			bool "AU 7.0 inch LCD Panel"

		config PANEL_LW500AC9601
			bool "CHIMEI 5.0 inch LCD panel"

	endchoice

	# config FTLCD_OSD
	# 	bool "Enable OSD (On Screen Display)"
	# 	depends on FB_FTLCDC100
	# 	default n
	# 	---help---
	# 	This enables access to the OSD (On Screen Display) for Faraday
	# 	FTLCDC100 LCD control.  Disabling OSD will reduce the size of
	# 	the kernel by approximately 6kb.
	#

	choice
	        prompt "Default Color Mode"
	        depends on FB_FTLCDC100
	        default FFB_MODE_RGB
	        help
	          This option select default color mode

		config FFB_MODE_RGB
			bool "RGB Mode"
		config FFB_MODE_YUV422
			bool "YUV422 Mode"
		config FFB_MODE_YUV420
			bool "YUV420 Mode"
	endchoice

	choice
	        prompt "Default BPP"
	        depends on FB_FTLCDC100
	        default FFB_MODE_16BPP
	        help
	          This option select default BPP (bits-per-pixel)

		config FFB_MODE_8BPP
			depends on FFB_MODE_RGB || FFB_MODE_YUV420
			bool "8 bits-per-pixel"
		config FFB_MODE_16BPP
			depends on FFB_MODE_RGB || FFB_MODE_YUV422
			bool "16 bits-per-pixel"
		config FFB_MODE_24BPP
			depends on FFB_MODE_RGB
			bool "24 bits-per-pixel"
	endchoice
```

## sound/v5/Kconfig
```kconfig
menu "ALSA RISCV devices"
	depends on SND!=n && RISCV

config SND_FTSSP010
	tristate "Faraday FTSSP010 audio Driver"
	depends on SND && RISCV
	depends on ATCDMAC300
	select SND_PCM
#	select SND_AC97_CODEC

choice
	prompt "AC97/I2S/HDA selection"
	depends on SND_FTSSP010
	default SND_FTSSP010_AC97
config SND_FTSSP010_AC97
	bool "AC97"
config SND_FTSSP010_I2S
	bool "I2S"
config SND_FTSSP010_HDA
	bool "HDA"
endchoice
endmenu
```
